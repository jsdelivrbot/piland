## buildroot-2017.08-rc3/package/lua-love/Config.in
```kconfig
config BR2_PACKAGE_LUA_LOVE
	bool "lua-love"
	depends on !BR2_STATIC_LIBS BR2_PACKAGE_LUAJIT
	select BR2_PACKAGE_SDL2
	select BR2_PACKAGE_OPENAL
	select BR2_PACKAGE_LIBMODPLUG
	select BR2_PACKAGE_LIBVORBIS
	select BR2_PACKAGE_LIBTHEORA
	select BR2_PACKAGE_PHYSFS
	select BR2_PACKAGE_MPG123
	help
	  TODO

comment "lua-love needs a toolchain w/ dynamic library"
	depends on BR2_STATIC_LIBS
```

## buildroot-2017.08-rc3/package/qt5/qt5wayland/Config.in
```kconfig
config BR2_PACKAGE_QT5WAYLAND
	bool "qt5wayland"
	select BR2_PACKAGE_QT5DECLARATIVE
	select BR2_PACKAGE_WAYLAND
	select BR2_PACKAGE_WAYLAND_PROTOCOLS
	select BR2_PACKAGE_LIBXKBCOMMON
	help
		Qt 5 Wayland module
```

## buildroot-2017.08/package/wayland-egl/Config.in
```kconfig
config BR2_PACKAGE_WAYLAND_EGL
	bool "wayland-egl"
	depends on BR2_PACKAGE_WAYLAND
	depends on BR2_PACKAGE_HAS_LIBEGL
	select BR2_PACKAGE_HAS_LIBEGL_WAYLAND
	help
	  Wayland EGL support.

	  http://wayland.freedesktop.org/
```
